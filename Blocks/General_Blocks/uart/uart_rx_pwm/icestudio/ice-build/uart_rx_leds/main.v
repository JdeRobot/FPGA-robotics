// Code generated by Icestudio 0.5.1w210224

`default_nettype none

//---- Top entity
module main #(
 parameter v5bcdac = 12000000,
 parameter v62129e = 115200
) (
 input v01f793,
 input vf8ed91,
 input vf31d3a,
 output [7:0] v701f74
);
 localparam p0 = v5bcdac;
 localparam p1 = v62129e;
 wire w2;
 wire w3;
 wire w4;
 wire w5;
 wire w6;
 wire [0:7] w7;
 wire w8;
 wire [0:7] w9;
 assign w2 = vf31d3a;
 assign w3 = vf8ed91;
 assign w4 = v01f793;
 assign w5 = v01f793;
 assign w6 = vf8ed91;
 assign v701f74 = w7;
 assign w5 = w4;
 assign w6 = w3;
 main_vdacd89 vdacd89 (
  .rst(w5),
  .clk(w6),
  .leds(w7),
  .dat_ready(w8),
  .uart_data(w9)
 );
 main_v0e0112 #(
  .G_FREQ_CLK(p0),
  .G_BAUD(p1)
 ) v0e0112 (
  .uart_rx(w2),
  .clk(w3),
  .rst(w4),
  .uart_dat_ready(w8),
  .uart_dat_o(w9)
 );
endmodule

/*-------------------------------------------------*/
/*--   */
/*-- - - - - - - - - - - - - - - - - - - - - - - --*/
/*-- 
/*-------------------------------------------------*/

module main_vdacd89 (
 input rst,
 input clk,
 input dat_ready,
 input [7:0] uart_data,
 output [7:0] leds
);
   reg [7:0] led;
   
   always @ (posedge rst, posedge clk)
   begin
     if (rst)
       led <= 0;
     else begin
       if (dat_ready)
         led <= uart_data;
     end
   end
   
   assign leds = led;
endmodule

module main_v0e0112 #(
 parameter G_FREQ_CLK = 0,
 parameter G_BAUD = 0
) (
 input rst,
 input clk,
 input uart_rx,
 output uart_dat_ready,
 output [7:0] uart_dat_o
);
 // @include uart_rx.v
 
 uart_rx
 #(.G_FREQ_CLK(G_FREQ_CLK), // board clk frequency
   .G_BAUD (G_BAUD)
 )
 i_uart_rx
 (
       .rst       (rst),
       .clk       (clk),
       .uart_rx   (uart_rx),
       //.receiving (uart_receiving),
       .dat_ready (uart_dat_ready),
       .dat_o     (uart_dat_o)
 );
endmodule
